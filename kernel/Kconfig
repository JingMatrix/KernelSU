## kernel/Kconfig
```kconfig
menu "KernelSU"

config KSU
	tristate "KernelSU function support"
	depends on OVERLAY_FS
	default y
	help
	  Enable kernel-level root privileges on Android System.
	  To compile as a module, choose M here: the
	  module will be called kernelsu.

config KSU_DEBUG
	bool "KernelSU debug mode"
	depends on KSU
	default y
	help
	  Enable KernelSU debug mode.

config KSU_UMOUNT
	bool "Umount overlayfs via LSM hooks"
	depends on KSU
	default n
	help
	  When disabled, the KernelSU setting of UMOUNT is a mere indicator of user configuration, instead of instructing KernelSU to umount overlayfs.

config KSU_KPROBES_HOOK
	bool "Integrate KernelSU via kprobe"
	depends on KSU && KPROBES
	default n
	help
	  If not enabled, then the kernel source must be changed to integrate KernelSU manually.

endmenu
```
